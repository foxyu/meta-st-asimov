## conf/layer.conf
```bitbake
# We have a conf and classes directory, add to BBPATH
BBPATH .= ":${LAYERDIR}"

# We have recipes-* directories, add to BBFILES
BBFILES += "${LAYERDIR}/recipes-*/*/*.bb \
            ${LAYERDIR}/recipes-*/*/*.bbappend"

BBFILE_COLLECTIONS += "meta-st-asimov"
BBFILE_PATTERN_meta-st-asimov = "^${LAYERDIR}/"
BBFILE_PRIORITY_meta-st-asimov = "6"

LAYERDEPENDS_meta-st-asimov = "core"
LAYERSERIES_COMPAT_meta-st-asimov = "dunfell"


#
# For support meta-st-asimov layer
#
STM32MP_DT_FILES_ASIMOV += "stm32mp157c-asimov"
STM32MP_DEVICETREE_append += " ${STM32MP_DT_FILES_ASIMOV}"

#UBOOT_EXTLINUX_TARGETS_EXTRA_CONFIG_target-sdcard += " ${STM32MP_DT_FILES_ASIMOV}"

DEVICE_BOARD_ENABLE_SDCARD += "${@bb.utils.contains('BOOTDEVICE_LABELS', 'sdcard', '${STM32MP_DT_FILES_ASIMOV}', '', d)}"
```
